## firmware/main/Kconfig.projbuild
```kconfig
menu "EventGuard-LoRa"
choice EG_ROLE
    prompt "Firmware role"
    default EG_ROLE_SENSOR
config EG_ROLE_SENSOR
    bool "Sensor Node"
config EG_ROLE_GATEWAY
    bool "Gateway Node"
endchoice

config EG_NODE_ID
    int "Sensor node ID"
    range 1 255
    default 1
config EG_GATEWAY_ID
    int "Gateway node ID"
    range 1 255
    default 2
config EG_E220_UART_NUM
    int "E220 UART controller"
    range 1 2
    default 1
config EG_E220_TX_GPIO
    int "E220 UART TX GPIO"
    range 0 48
    default 17
config EG_E220_RX_GPIO
    int "E220 UART RX GPIO"
    range 0 48
    default 18
config EG_E220_AUX_GPIO
    int "E220 AUX GPIO (-1 disables AUX polling)"
    range -1 48
    default 15
config EG_E220_M0_GPIO
    int "E220 M0 GPIO"
    range 0 48
    default 13
config EG_E220_M1_GPIO
    int "E220 M1 GPIO"
    range 0 48
    default 14
config EG_E220_BAUD
    int "E220 UART baud"
    range 1200 115200
    default 9600
config EG_E220_ADDRESS
    int "Expected E220 transparent-mode address"
    range 0 65535
    default 0
config EG_E220_REG0
    int "Expected E220 REG0 value"
    range 0 255
    default 98
config EG_E220_CHANNEL
    int "Expected E220 channel register"
    range 0 83
    default 23
config EG_ACK_TIMEOUT_MS
    int "ACK timeout in milliseconds"
    range 20 2000
    default 1000
config EG_DIAGNOSTIC_MODE
    bool "Enable E220 receive-path diagnostic instrumentation and commands"
    default n
config EG_I2C_SDA_GPIO
    int "Sensor I2C SDA GPIO"
    range 0 48
    default 8
config EG_I2C_SCL_GPIO
    int "Sensor I2C SCL GPIO"
    range 0 48
    default 9
config EG_SOIL_ADC_GPIO
    int "Soil ADC GPIO (GPIO4 / ADC1 channel 3 in this profile)"
    range 0 48
    default 4
config EG_MAX_REDUNDANCY
    int "Maximum copies per logical packet"
    range 1 3
    default 3
config EG_FIXED_REDUNDANCY
    int "Fixed baseline copies"
    range 1 3
    default 2
endmenu
```
